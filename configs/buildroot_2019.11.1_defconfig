## configs/buildroot_2019.11.1_defconfig
```kconfig
BR2_aarch64=y
BR2_KERNEL_HEADERS_CUSTOM_GIT=y
BR2_KERNEL_HEADERS_CUSTOM_REPO_URL="/labs/linux-lab/linux-stable"
BR2_KERNEL_HEADERS_CUSTOM_REPO_VERSION="v5.1"
BR2_PACKAGE_HOST_LINUX_HEADERS_CUSTOM_5_1=y
BR2_TARGET_GENERIC_HOSTNAME="linux-lab"
BR2_TARGET_GENERIC_ISSUE="Welcome to Linux Lab"
BR2_TARGET_GENERIC_GETTY_PORT="ttyAMA0"
BR2_PACKAGE_BUSYBOX_SHOW_OTHERS=y
BR2_PACKAGE_BASH=y
BR2_TARGET_ROOTFS_CPIO=y
BR2_TARGET_ROOTFS_CPIO_GZIP=y
BR2_TARGET_ROOTFS_EXT2=y
BR2_TARGET_ROOTFS_EXT2_GZIP=y
```
